/* Esp32Droid — the MaestroPCA co-processor on an ESP32.

   *** EDIT Config.h. NOTHING IN THIS FILE. ***

   ⚠ UNTESTED ON HARDWARE. Every line below compiles from the same library
   the Nano version does, and the parts that can be checked without a board
   are checked (arduino/MaestroPCA/test/ledc_test.cpp — duty arithmetic,
   the pin/channel bookkeeping on BOTH arduino-esp32 cores, the 16-channel
   ceiling, and the engine driving it end to end; ripple_test.cpp measures
   what the servo is actually shown). What no fake can prove is whether the
   silicon then emits the pulse. Flash it expecting to find something.

   v1.68.0 fixed the one thing a compile could never have caught: on a 2.x
   core this used the GPIO NUMBER as the LEDC channel, and not one servo
   would have moved. See the long note in MpcaEsp32.h.

   ------------------------------------------------------- why an ESP32
   Not for the motion. A £4 Nano already runs this engine — four concurrent
   tracks, easing, background layers, release-when-parked — at 100 Hz in
   27 KB, and motion quality through a PCA9685 is set by its 4.88 µs steps,
   not by the processor asking for them.

   Two things an ESP32 adds that a Nano cannot:

     1. A RADIO. Fire a routine from your phone at a convention without
        opening the dome. OFF by default (ESP_WIFI in Config.h) — the web
        server blocks the same loop the motion runs in, and the judder
        that causes is measured in ripple_test.cpp. Turn it on knowing
        that; the note in Config.h 4/6 says what a proper fix looks like.

     2. DIRECT PIN DRIVE, for sixteen servos or fewer. The ESP32's LEDC
        peripheral does 16 hardware PWM channels at 16-bit resolution —
        about 0.3 µs a step, better than a PCA9685 and close to a Maestro.
        No expander, no I2C, no address jumpers. Set MPCA_DIRECT_PINS.

   Past sixteen channels, LEDC runs out and you are back to PCA9685s, which
   this sketch also supports — the radio is still the point.

   ---------------------------------------------------------------- wiring
   DIRECT (MPCA_DIRECT_PINS 1):
     servo signal  <- the GPIOs in SERVO_PINS below, one per channel
     servo V+      <- its own 5–6 V supply, NEVER the ESP32's pins
     GND           -- supply, ESP32 and every servo, one common point

   EXPANDER (MPCA_DIRECT_PINS 0):
     SDA 21 · SCL 22  -> PCA9685 SDA/SCL      3.3 V logic is a valid high
     3V3 -> VCC (logic only)                  for a PCA9685; do not feed
     V+  <- the servo supply                  5 V back into an ESP32 pin

   A SECOND BOARD (MPCA_SPLIT_LOCAL > 0):
     SPLIT_TX_PIN -> the slave's LINK_RX_PIN     one wire, plus ground
     GND ---------- the slave's GND              (nothing comes back)

   THE DROID LINK, either way — the host sends restartScript(n) here:
     host TX -> LINK_RX_PIN        host GND -- ESP32 GND
     LINK_TX_PIN -> host RX        (only if the host reads position back)

   ------------------------------------------------------------- console
   Serial Monitor at 115200, and the same keys as MaestroReplacement:
     ?  status   v  log every command from the host   w  walk every channel
     t  sweep channel 0     0-9  run that slot     x  stop, all outputs off
                                                                       */

#include "MaestroPCA.h"
#include "MaestroLink.h"
#include "MpcaEsp32.h"
#include "sequences.h"          /* generated by PCA Studio / the simulator */

/* ====================================================== your settings */
#include "Config.h"       /* <<<<<< THE ONLY FILE YOU EDIT */

/* SERVO_PINS[i] is the GPIO for CHANNEL i. The list is in Config.h; the
   array is built here so the COUNT is derived from it and never typed
   twice — a hand-kept count beside a hand-kept list is how channels go
   quietly dead. */
static const uint8_t SERVO_PINS[] = { SERVO_PINS_LIST };
#define SERVO_PIN_COUNT (sizeof(SERVO_PINS)/sizeof(SERVO_PINS[0]))

/* Two ways to wire this wrong that a compiler CAN catch, so it does. The
   runtime warnings below stay as well — they cover the PCA9685 route,
   where the shortfall is boards on a bus rather than anything in a file. */
#if MPCA_DIRECT_PINS
  #if MPCA_CHANNELS > 16
    #error "MPCA_DIRECT_PINS drives at most 16 channels — that is the LEDC peripheral's channel count, not a setting. Your sequences.h declares more. Set MPCA_DIRECT_PINS to 0 in Config.h and use PCA9685 boards, or export a smaller table."
  #endif
#endif

/* ============================================================ the rig */
#if MPCA_DIRECT_PINS
  MpcaLedcOutput output(SERVO_PINS, sizeof(SERVO_PINS)/sizeof(SERVO_PINS[0]));
#else
  #include <Wire.h>
  #include <Adafruit_PWMServoDriver.h>
  #include "MpcaScan.h"
  #ifndef PCA_BOARDS
  #define PCA_BOARDS  ((MPCA_CHANNELS + 15) / 16)
  #endif
  /* v1.53.0 — a starting point, not an assumption: mpcaScan() re-addresses
     these at boot to whatever is actually on the bus, in ascending address
     order. This sketch did not probe at all before, so a board on a
     different jumper setting was simply written to and never answered. */
  static Adafruit_PWMServoDriver pca0(0x40), pca1(0x41), pca2(0x42), pca3(0x43);
  static Adafruit_PWMServoDriver* const BOARDS[] = { &pca0, &pca1, &pca2, &pca3 };
  static uint8_t pcaFound[4], pcaOnBus = 0, pcaBound = 0;
  MpcaPca9685Output output(BOARDS, PCA_BOARDS);
#endif

#if MPCA_SPLIT_LOCAL
  /* `output` becomes the LOCAL half; the split wraps it and forwards the
     rest. The channel table needs no change — it already says which board
     every channel is on, and nothing ever promised a board was here. */
  MpcaSplitOutput splitOut(output, MPCA_SPLIT_LOCAL, Serial2);
  #define MPCA_OUT splitOut
#else
  #define MPCA_OUT output
#endif

MaestroPCA  maestro(MPCA_OUT, MPCA_CHANNEL_TABLE, MPCA_CHANNELS,
                    MPCA_SEQ_TABLE, MPCA_SEQUENCES);
MaestroLink parser(maestro);

#if ESP_WIFI
  #include <WiFi.h>
  #include <WebServer.h>
  WebServer web(80);
#endif

bool     verbose = false, sweeping = false, walkOn = false;
uint32_t sweepAt = 0, walkAt = 0, lastHostMs = 0;
uint8_t  walkCh = 0;
bool     hostSeen = false, safeState = false;
#if ESP_WIFI
String   netWhere = "offline";
#endif

/* ------------------------------------------------------------- console */
void status(){
  Serial.println(F("--- MAESTRO-PCA (ESP32) ---"));
#if MPCA_DIRECT_PINS
  Serial.print(F("  output: ESP32 pins, "));
  Serial.print(output.channels()); Serial.print(F(" channels at "));
  Serial.print(output.bits()); Serial.println(F("-bit"));
  if(output.overflowed())
    Serial.println(F("  !! the table wants more channels than LEDC has — the top ones are DEAD."
                     " Use PCA9685s (MPCA_DIRECT_PINS 0) above 16."));
  if(MPCA_CHANNELS > (int)SERVO_PIN_COUNT)
    Serial.println(F("  !! sequences.h declares more channels than SERVO_PINS lists"));
#else
  Serial.println(F("  output: PCA9685 over I2C"));
#endif
#if MPCA_SPLIT_LOCAL
  Serial.print(F("  split: boards 0-")); Serial.print(MPCA_SPLIT_LOCAL - 1);
  Serial.print(F(" here, the rest to an Esp32Slave — "));
  Serial.print(splitOut.framesSent()); Serial.println(F(" frames sent"));
  if(!splitOut.framesSent())
    Serial.println(F("  !! nothing has crossed the link yet — check TX/RX and the common ground"));
#endif
#if ESP_WIFI
  Serial.print(F("  network: ")); Serial.println(netWhere);
#else
  Serial.println(F("  network: off (ESP_WIFI 0 in Config.h)"));
#endif
  Serial.print(F("  commands parsed: ")); Serial.print(parser.commandCount());
  Serial.print(F("   bad: ")); Serial.println(parser.badCount());
  Serial.print(F("  channels ")); Serial.print(MPCA_CHANNELS);
  Serial.print(F("   slots ")); Serial.println(MPCA_SEQUENCES);
  Serial.print(F("  script: "));
  if(maestro.scriptRunning()){ Serial.print(F("running ")); Serial.print(maestro.runningCount()); Serial.println(F(" track(s)")); }
  else Serial.println(F("idle"));
  Serial.println(F("  keys: ? status  v verbose  t sweep  w walk  0-9 slot  x off"));
}

void allOff(){
  sweeping = false; walkOn = false;
  maestro.stopScript();
  for(uint8_t i = 0; i < MPCA_CHANNELS; i++) maestro.setTarget(i, 0);
}

#if ESP_WIFI
/* ------------------------------------------------------------ the web
   Deliberately tiny and deliberately GET-only: this is a page you open on
   a phone with one hand while holding a droid panel with the other. */
String pageHtml(){
  String h = F("<!doctype html><meta name=viewport content='width=device-width,initial-scale=1'>"
               "<title>R2 sequences</title><style>"
               "body{background:#111417;color:#d7dde2;font:16px/1.6 system-ui;margin:0;padding:18px}"
               "h1{font:600 17px/1.3 monospace;color:#f0a832;margin:0 0 4px}"
               ".s{color:#8a949d;font:12px/1.5 monospace;margin-bottom:16px}"
               "a.b{display:block;background:#191e23;border:1px solid #2c353d;border-radius:8px;"
               "padding:14px 16px;margin:8px 0;color:#d7dde2;text-decoration:none}"
               "a.b b{color:#f0a832;font-family:monospace;margin-right:10px}"
               "a.stop{border-color:#e0483a;color:#e0483a}</style>");
  h += F("<h1>R2 &mdash; sequences</h1><div class=s>");
  h += String(MPCA_SEQUENCES) + F(" slots &middot; ") + String(MPCA_CHANNELS) + F(" channels &middot; ");
  h += maestro.scriptRunning() ? F("running") : F("idle");
  h += F("</div>");
  for(uint8_t i = 0; i < MPCA_SEQUENCES; i++)
    h += "<a class=b href='/run?slot=" + String(i) + "'><b>" + String(i) + "</b>run this slot</a>";
  h += F("<a class='b stop' href='/stop'>&#9632; STOP &mdash; all outputs off</a>");
  return h;
}
void webSetup(){
  web.on("/", [](){ web.send(200, "text/html", pageHtml()); });
  web.on("/run", [](){
    int slot = web.hasArg("slot") ? web.arg("slot").toInt() : -1;
    if(slot < 0 || slot >= MPCA_SEQUENCES){ web.send(400, "text/plain", "no such slot"); return; }
    maestro.restartScript((uint8_t)slot);
    if(verbose){ Serial.print(F("web: restartScript(")); Serial.print(slot); Serial.println(')'); }
    /* straight back to the list, so the phone stays on one page */
    web.sendHeader("Location", "/"); web.send(303);
  });
  web.on("/stop", [](){
    allOff();
    web.sendHeader("Location", "/"); web.send(303);
  });
  web.on("/status", [](){
    String j = "{\"channels\":" + String(MPCA_CHANNELS) +
               ",\"slots\":" + String(MPCA_SEQUENCES) +
               ",\"running\":" + String(maestro.runningCount()) +
               ",\"commands\":" + String(parser.commandCount()) +
               ",\"bad\":" + String(parser.badCount()) + "}";
    web.send(200, "application/json", j);
  });
  web.onNotFound([](){ web.send(404, "text/plain", "no"); });
  web.begin();
}
void wifiSetup(){
  if(strlen(WIFI_SSID)){
    WiFi.mode(WIFI_STA);
    WiFi.begin(WIFI_SSID, WIFI_PASS);
    uint32_t t0 = millis();
    while(WiFi.status() != WL_CONNECTED && millis() - t0 < WIFI_JOIN_MS) delay(200);
    if(WiFi.status() == WL_CONNECTED){
      netWhere = String("http://") + WiFi.localIP().toString() + "  (" + WIFI_SSID + ")";
      return;
    }
    Serial.println(F("  wifi: could not join — falling back to my own access point"));
  }
  /* An AP of its own is the honest default for a droid: no network to
     depend on, and the phone connects to the machine rather than the other
     way round. */
  WiFi.mode(WIFI_AP);
  WiFi.softAP(AP_SSID, strlen(AP_PASS) >= 8 ? AP_PASS : NULL);
  netWhere = String("http://") + WiFi.softAPIP().toString() + "  (join \"" + AP_SSID + "\")";
}
#endif  /* ESP_WIFI */

/* ---------------------------------------------------------------- boot */
void setup(){
  Serial.begin(CONSOLE_BAUD);
  delay(200);
#if !MPCA_DIRECT_PINS
  Wire.begin(21, 22);
  Wire.setClock(400000);
  delay(50);
  /* SCAN, then bind, then begin — maestro.begin() below calls begin() on
     every board, and re-addressing after that would strand Adafruit's own
     allocation (MpcaScan.h) */
  pcaOnBus = mpcaScan(pcaFound, 4);
  pcaBound = mpcaBind(BOARDS, PCA_BOARDS, pcaFound, pcaOnBus);
#endif
  Serial1.begin(LINK_BAUD, SERIAL_8N1, LINK_RX_PIN, LINK_TX_PIN);
#if MPCA_SPLIT_LOCAL
  Serial2.begin(SPLIT_BAUD, SERIAL_8N1, SPLIT_RX_PIN, SPLIT_TX_PIN);
#endif

  maestro.begin(OSC_HZ, SERVO_HZ);

  Serial.println(F("MAESTRO-PCA-ESP32 1"));
#if !MPCA_DIRECT_PINS
  Serial.print(F("  I2C: ")); Serial.print(pcaOnBus);
  Serial.print(F(" PCA9685(s) found, ")); Serial.print(pcaBound);
  Serial.println(F(" in use"));
  for(uint8_t b = 0; b < pcaBound; b++){
    Serial.print(F("    board ")); Serial.print(b);
    Serial.print(F(" = 0x")); Serial.print(pcaFound[b], HEX);
    Serial.print(F("   channels ")); Serial.print(b*16);
    Serial.print(F("-")); Serial.println(b*16+15);
  }
  if(pcaBound < PCA_BOARDS)
    Serial.println(F("    FEWER BOARDS THAN THE TABLE NEEDS — the top channels will not move"));
#endif
#if ESP_WIFI
  wifiSetup();
  webSetup();
#endif
  status();
}

void loop(){
  /* THE rule, unchanged from every other sketch in this library: update()
     every pass, and never delay() anywhere near it. */
  maestro.update();
#if ESP_WIFI
  /* ⚠ THIS BLOCKS. arduino-esp32's WebServer waits up to 5 s for a client
     that has opened a socket and not finished its request, and nothing
     calls maestro.update() while it does. See Config.h 4/6. */
  web.handleClient();
#endif

  /* the droid link */
  while(Serial1.available()){
    uint8_t out[2];
    uint8_t n = parser.feed((uint8_t)Serial1.read(), out);
    if(n) Serial1.write(out, n);
    lastHostMs = millis(); hostSeen = true; safeState = false;
  }
  static uint32_t seenCmds = 0;
  if(verbose && parser.commandCount() != seenCmds){
    seenCmds = parser.commandCount();
    Serial.print(F("host: 0x")); Serial.print(parser.lastCommand(), HEX);
    if(parser.lastCommand() == 0xA7){ Serial.print(F("  restartScript(")); Serial.print(parser.lastArg()); Serial.print(')'); }
    Serial.println();
  }
  if(hostSeen && !safeState && millis() - lastHostMs > WATCHDOG_MS){
    safeState = true;
    allOff();
    Serial.print(F("!! no word from the host for ")); Serial.print(WATCHDOG_MS / 1000);
    Serial.println(F(" s — safe state"));
  }

  /* bench helpers */
  if(sweeping && millis() - sweepAt > 1500){
    sweepAt = millis();
    static bool hi = false; hi = !hi;
    maestro.setTarget(0, hi ? 7000 : 5000);
  }
  if(walkOn && millis() - walkAt > 700){
    walkAt = millis();
    if(walkCh) maestro.setTarget(walkCh - 1, 0);
    if(walkCh >= MPCA_CHANNELS){ walkOn = false; Serial.println(F("walk done")); }
    else { maestro.setTarget(walkCh, 6500); Serial.print(F("  ch")); Serial.println(walkCh); walkCh++; }
  }

  while(Serial.available()){
    char c = Serial.read();
    if(c >= '0' && c <= '9'){
      uint8_t n = c - '0';
      if(n >= MPCA_SEQUENCES){ Serial.println(F("no such slot")); continue; }
      maestro.restartScript(n);
      Serial.print(F("slot ")); Serial.println(n);
    }
    else if(c == '?') status();
    else if(c == 'v'){ verbose = !verbose; Serial.println(verbose ? F("verbose on") : F("verbose off")); }
    else if(c == 't'){ sweeping = true; sweepAt = millis(); Serial.println(F("sweeping ch0 — x to stop")); }
    else if(c == 'w'){ walkOn = true; walkCh = 0; walkAt = millis(); Serial.println(F("walking every channel")); }
    else if(c == 'x'){ allOff(); Serial.println(F("all off")); }
  }
}
