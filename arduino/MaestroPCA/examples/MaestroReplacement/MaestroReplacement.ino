/* MaestroReplacement — turn a £4 Nano + a £5 PCA9685 into a Pololu
   Mini Maestro, as far as your droid's host board is concerned.

   WHY A SECOND PROCESSOR. The host sends `maestro.restartScript(2)` —
   three bytes — and immediately goes back to driving, sound and reading
   the controller. THIS board runs the whole panel choreography. That
   isolation is what a Maestro really sells you: the host can stall on
   Usb.Task() or a delay() and the panels keep easing, because they are
   different CPUs. No single-board arrangement reproduces that.

   YOUR HOST SKETCH NEEDS NO CHANGES. Keep PololuMaestro, keep
   `MiniMaestro maestro(Serial3);`, keep every restartScript() call and
   every slot number. Only the box on the other end of the wire changes.

   ---------------------------------------------------------------- wiring
     host TX  (Mega Serial3 TX = pin 14)  ->  pin 8   (LINK_RX)
     pin 9    (LINK_TX)                   ->  host RX (only if the host
                                              ever reads position back)
     host GND ------------------------------  GND      <- always
     A4 SDA -> PCA9685 SDA        A5 SCL -> PCA9685 SCL
     5V     -> PCA9685 VCC        GND    -> PCA9685 GND
     PCA9685 V+  <- its own 5-6 V servo supply, sharing that GND

   The usual "SoftwareSerial breaks PWM" warning does NOT apply here:
   this board generates no PWM at all — the PCA9685 does. Using pins 8/9
   for the link leaves USB free for flashing and the console below.

   ------------------------------------------------------------- console
   Open the Serial Monitor at 115200 while it runs:
     ?  status — I2C scan, link counters, what the host last sent
     v  toggle live logging of every command the host sends
     t  sweep channel 0 (proves servo + power without the host)
     0-9 run that sequence slot, exactly as restartScript(n) would
     x  stop and switch everything off
   `v` is the answer to the fault that makes a Maestro look dead: if the
   host's restartScript() never arrives, you SEE that here.            */

#include <Wire.h>
#include <SoftwareSerial.h>
#include <Adafruit_PWMServoDriver.h>
/* OURS — quoted, not <angled>. A sketch folder is NOT on the compiler's
   include path for an <angled> include: the IDE answers
   "MpcaScan.h: No such file or directory" even with the file sitting right
   beside this one. A QUOTED include searches this directory first and the
   library path afterwards, so it finds the copies in this folder, and still
   finds the library for anyone who deletes them and installs
   arduino/MaestroPCA/ instead. Both ways work; angled only ever worked the
   second way. */
#include "MpcaScan.h"
#include "MaestroPCA.h"
#include "MaestroLink.h"
#include "sequences.h"          /* <- generated by PCA Studio / the simulator */

/* ------------------------------------------------------------ config */
#define LINK_RX_PIN   8
#define LINK_TX_PIN   9
#define LINK_BAUD     9600      /* must match the host's Serial3.begin() */
/* How many PCA9685s. Derived from the channel count in sequences.h so it
   cannot silently disagree with it: a channel on a board that was never
   declared is skipped with no error at all, which looks exactly like dead
   wiring. Override only if you have more boards than channels need. */
#ifndef PCA_BOARDS
#define PCA_BOARDS  ((MPCA_CHANNELS + 15) / 16)
#endif
#if MPCA_CHANNELS > PCA_BOARDS * 16
#error "PCA_BOARDS is too small for MPCA_CHANNELS - the top channels would never be driven"
#endif
#define OSC_HZ        25000000UL/* measured PCA9685 oscillator, see README */

/* LINK WATCHDOG. If the host crashes, resets or the wire falls out
   mid-sequence, this board would otherwise carry on animating for ever.
   After this long with no command it goes to a known state — the same
   idea as the setTimeout(950) your Sabertooth already relies on.
   0 disables it.  WATCHDOG_LIMP: true = drop everything limp (safest for
   panels that rest closed), false = hold the home pose. */
#define WATCHDOG_MS   8000
#define WATCHDOG_LIMP false

SoftwareSerial link(LINK_RX_PIN, LINK_TX_PIN);

/* v1.53.0 — these addresses are only a STARTING point: the bus is
   scanned at boot and the drivers are re-addressed to whatever is
   actually there, in ascending address order (MpcaScan.h says why, and
   why the All Call address must be excluded from the sweep). Bridge A1
   instead of A0 and this still works.

   v1.54.0 — EIGHT of them, not two. A droid with two boards in the dome
   and one in the body already needs three, and the only thing that ever
   made two the number was the six-bit channel field in the live-drive
   wire protocol (see the frame decoder below). That field is seven bits
   now. Boards that are not on the bus cost a few bytes of RAM and are
   never spoken to, so declaring the ceiling here is free — what a given
   droid actually drives is still decided by MPCA_CHANNELS. */
Adafruit_PWMServoDriver pcaObj[8] = {
  Adafruit_PWMServoDriver(0x40), Adafruit_PWMServoDriver(0x41),
  Adafruit_PWMServoDriver(0x42), Adafruit_PWMServoDriver(0x43),
  Adafruit_PWMServoDriver(0x44), Adafruit_PWMServoDriver(0x45),
  Adafruit_PWMServoDriver(0x46), Adafruit_PWMServoDriver(0x47)
};
Adafruit_PWMServoDriver* const BOARDS[] = {
  &pcaObj[0], &pcaObj[1], &pcaObj[2], &pcaObj[3],
  &pcaObj[4], &pcaObj[5], &pcaObj[6], &pcaObj[7]
};
uint8_t boardAddr[8] = { 0x40, 0x41, 0x42, 0x43, 0x44, 0x45, 0x46, 0x47 };
uint8_t boardsOnBus = 0;                /* everything, not just what we use */
#define PCA_MAX_BOARDS (sizeof(BOARDS)/sizeof(BOARDS[0]))

/* Which boards actually answered, regardless of how many this config uses.
   A board the flashed sequences.h does not mention still gets woken up and
   is still reachable from PCA Studio — otherwise tuning a 32-channel rig
   would need a 32-channel sequences.h flashed first, and the extra board
   would appear simply dead. */
bool boardLive[PCA_MAX_BOARDS];

MaestroPCA  maestro(BOARDS, PCA_BOARDS,
                    MPCA_CHANNEL_TABLE, MPCA_CHANNELS,
                    MPCA_SEQ_TABLE, MPCA_SEQUENCES);
MaestroLink parser(maestro);     /* device 255 = answer any address, CRC off */

bool verbose = false;
bool sweeping = false;
uint32_t lastCmdAt = 0;
uint32_t lastCmdSeen = 0;
bool     watchdogTripped = false;
/* live drive from PCA Studio over USB — see the console block in loop() */
bool     liveMode = false;
uint8_t  ust = 0, uch = 0;      /* 3-byte frame state machine */
uint16_t upay = 0;
uint32_t oscHz = OSC_HZ;
float    servoHz = 50.0f;
uint32_t sweepAt = 0;
int16_t  sweepPos = 256;
int8_t   sweepDir = 1;

void applyClock(){
  for(uint8_t b = 0; b < PCA_MAX_BOARDS; b++){
    if(!boardLive[b]) continue;
    BOARDS[b]->setOscillatorFrequency(oscHz);
    BOARDS[b]->setPWMFreq(servoHz);
  }
}

/* Step through every channel on every live board, one at a time, so you
   can see exactly which physical servo answers to which channel number.
   Writes straight to the boards, bypassing the config, because the whole
   point is to test wiring that the config may not describe yet. */
bool     walkOn = false;
uint8_t  walkCh = 0, walkPhase = 0;
uint32_t walkAt = 0;
void walkStep(){
  uint8_t bd = walkCh >> 4, pn = walkCh & 15;
  if(bd >= PCA_MAX_BOARDS){ walkOn = false; Serial.println(F("walk done")); return; }
  if(!boardLive[bd]){ walkCh = (bd + 1) * 16; walkPhase = 0; return; }
  if(walkPhase == 0){
    Serial.print(F("  channel ")); Serial.print(walkCh);
    Serial.print(F("  = board 0x")); Serial.print(boardAddr[bd], HEX);
    Serial.print(F(" pin ")); Serial.println(pn);
    BOARDS[bd]->setPWM(pn, 0, 358);          /* 1750 us */
    walkPhase = 1; walkAt = millis() + 600;
  }else if(walkPhase == 1){
    BOARDS[bd]->setPWM(pn, 0, 256);          /* 1250 us */
    walkPhase = 2; walkAt = millis() + 600;
  }else{
    BOARDS[bd]->setPWM(pn, 0, 4096);         /* off, so only one moves at a time */
    walkPhase = 0; walkAt = millis();
    if(++walkCh >= PCA_MAX_BOARDS * 16){ walkOn = false; Serial.println(F("walk done")); }
  }
}

/* PCA Studio has taken the servos. Stop the board animating so the two do
   not fight over the same outputs, and let the incoming positions own them. */
void enterLive(){
  if(liveMode) return;
  liveMode = true;
  maestro.stopScript();
  for(uint8_t i = 0; i < MPCA_CHANNELS; i++) maestro.setTarget(i, 0);
  Serial.println(F("live drive ON — PC has the servos (run any slot to take them back)"));
}
void leaveLive(){
  if(!liveMode) return;
  liveMode = false;
  Serial.println(F("live drive off — the board has the servos again"));
}

void status(){
  Serial.println(F("MAESTRO-PCA 3"));      /* 2 = live drive; 3 = 7-bit channels */
  Serial.println(F("--- Maestro replacement ---"));
  /* v1.53.0 — this used to sweep 0x40-0x4F and assume address minus 0x40
     was the board number, which is only true if you bridged the jumpers
     the way this sketch happened to expect. The mapping is now whatever
     the boot scan settled on, printed as the mapping it is. */
  Serial.print(F("  I2C: "));
  Serial.print(boardsOnBus); Serial.println(F(" PCA9685(s) on the bus"));
  /* v1.54.0 — eight board slots, so only the ones that answered are
     listed. Printing five "MISSING" lines for jumpers nobody bridged is
     noise, and noise is what stops people reading the one line that
     matters. A board found beyond what sequences.h declares is not an
     error: it is woken and live-drivable, just not animated by the
     flashed slots. */
  for(uint8_t b = 0; b < PCA_MAX_BOARDS; b++){
    if(!boardLive[b]) continue;
    Serial.print(F("    board ")); Serial.print(b);
    Serial.print(F(" = 0x")); Serial.print(boardAddr[b], HEX);
    if(b * 16 >= MPCA_CHANNELS){
      Serial.println(F("   spare — live drive only, no slots use it"));
    }else{
      Serial.print(F("   channels ")); Serial.print(b * 16);
      Serial.print(F("-")); Serial.println(min(MPCA_CHANNELS - 1, b * 16 + 15));
    }
  }
  if(boardsOnBus > PCA_MAX_BOARDS){
    Serial.print(F("    ")); Serial.print(boardsOnBus - PCA_MAX_BOARDS);
    Serial.print(F(" more board(s) on the bus than this sketch drives ("));
    Serial.print(PCA_MAX_BOARDS); Serial.println(F(" boards, 128 channels max)"));
  }
  if(!boardsOnBus) Serial.println(F("    nothing on the bus — check SDA/SCL, VCC, shared ground"));
  Serial.print(F("  channels ")); Serial.print(MPCA_CHANNELS);
  Serial.print(F("   slots ")); Serial.println(MPCA_SEQUENCES);
  Serial.print(F("  link  pin ")); Serial.print(LINK_RX_PIN);
  Serial.print(F(" @ ")); Serial.print(LINK_BAUD); Serial.println(F(" baud"));
  Serial.print(F("  commands from host: ")); Serial.print(parser.commandCount());
  Serial.print(F("   bad: ")); Serial.println(parser.badCount());
  if(parser.commandCount() == 0){
    Serial.println(F("  NOTHING RECEIVED YET. If the droid is running, check:"));
    Serial.println(F("  host TX to pin 8, grounds tied, matching baud rate."));
  }else{
    Serial.print(F("  last: 0x")); Serial.print(parser.lastCommand(), HEX);
    Serial.print(F(" arg ")); Serial.println(parser.lastArg());
  }
  Serial.print(F("  watchdog: "));
  if(!WATCHDOG_MS) Serial.println(F("off"));
  else if(watchdogTripped) Serial.println(F("TRIPPED — no command from the host"));
  else { Serial.print(WATCHDOG_MS); Serial.println(F(" ms")); }
  Serial.print(F("  live drive: ")); Serial.println(liveMode ? F("ON — PC is driving") : F("off"));
  Serial.print(F("  script: "));
  if(maestro.scriptRunning()){ Serial.print(F("running slot ")); Serial.println(maestro.currentScript()); }
  else Serial.println(F("idle"));
  Serial.println(F("  keys: ? status  v verbose  t sweep  w walk all  0-9 slot  x off"));
}

void setup(){
  Serial.begin(115200);
  link.begin(LINK_BAUD);
  Wire.begin();
  Wire.setClock(400000);
  delay(50);

  /* SCAN, then bind, then begin — in that order. mpcaBind() re-addresses
     the driver objects and Adafruit allocates its I2C device inside
     begin(), so binding afterwards would strand the allocation. */
  uint8_t found[PCA_MAX_BOARDS];
  boardsOnBus = mpcaScan(found, PCA_MAX_BOARDS);
  uint8_t bound = mpcaBind(BOARDS, PCA_MAX_BOARDS, found, boardsOnBus);
  for(uint8_t b = 0; b < PCA_MAX_BOARDS; b++){
    boardLive[b] = (b < bound);
    if(boardLive[b]){ boardAddr[b] = found[b]; BOARDS[b]->begin(); }
  }
  maestro.begin(oscHz);          /* applies each channel's home/off state */
  applyClock();                  /* including boards outside the config */

  status();                      /* prints the MAESTRO-PCA banner itself */
}

void loop(){
  /* ---- the whole job: bytes in, animation out ---- */
  while(link.available()){
    uint8_t reply[2];
    uint8_t n = parser.feed(link.read(), reply);
    if(n) link.write(reply, n);              /* getPosition etc. answer back */
    leaveLive();                             /* the droid outranks the PC */
    if(verbose && parser.commandCount()){
      static uint32_t seen = 0;
      if(parser.commandCount() != seen){
        seen = parser.commandCount();
        Serial.print(F("host: 0x")); Serial.print(parser.lastCommand(), HEX);
        if(parser.lastCommand() == 0xA7){
          Serial.print(F("  restartScript(")); Serial.print(parser.lastArg()); Serial.print(F(")"));
        }
        Serial.println();
      }
    }
  }

  maestro.update();                          /* THE rule: every pass, never delay() */

  /* ---- link watchdog ---- */
  if(WATCHDOG_MS){
    if(parser.commandCount() != lastCmdSeen){
      lastCmdSeen = parser.commandCount();
      lastCmdAt = millis();
      if(watchdogTripped){ watchdogTripped = false; Serial.println(F("host is back")); }
    }
    /* only arm once the host has actually said something, so a board
       powered up on the bench with no host does not trip immediately */
    if(lastCmdSeen && !watchdogTripped && millis() - lastCmdAt > WATCHDOG_MS){
      watchdogTripped = true;
      maestro.stopScript();
      if(WATCHDOG_LIMP) for(uint8_t i=0;i<MPCA_CHANNELS;i++) maestro.setTarget(i, 0);
      else maestro.goHome();
      Serial.println(F("WATCHDOG: no command from the host — safe state"));
    }
  }

  /* ---- console: text commands AND PCA Studio's live drive ----
     Both share this port, and they cannot be told apart byte by byte — so
     the binary protocol gets a frame state machine, exactly as PCA_Bridge
     has. A payload byte is consumed as payload and can therefore never be
     mistaken for a keypress, which is what used to make Studio fire slots
     at random here. A frame arriving means the PC wants the servos, so the
     board stops animating until a slot key takes them back.

     PROTOCOL 2 (v1.54.0). The header byte's high bit marks the frame; the
     channel used to be read out of only six of the remaining seven bits,
     which capped live drive at 32 channels — two boards — because 62 and
     63 were spent on configuration. Reading all seven gives 0..127, and
     the config channels move to 126 and 127. The cost is that board 7's
     top two pins are not drivable from the browser; every other channel
     is, and the flashed sequences drive all 128 regardless, since they
     never travel over this wire. The banner below says 3 so the app knows
     which decoder is on the other end. */
  while(Serial.available()){
    uint8_t b = Serial.read();

    if(b & 0x80){ uch = b & 0x7F; upay = 0; ust = 1; continue; }
    if(ust == 1){ upay = (uint16_t)b << 7; ust = 2; continue; }
    if(ust == 2){
      upay |= b; ust = 0;
      enterLive();
      if(uch == 126){ oscHz = (uint32_t)upay * 10000UL; applyClock(); }
      else if(uch == 127){ servoHz = upay; applyClock(); }
      else {
        uint8_t bd = uch >> 4, pn = uch & 15;
        if(bd < PCA_MAX_BOARDS && boardLive[bd]){
          if(upay == 8191) BOARDS[bd]->setPWM(pn, 0, 4096);       /* full off */
          else             BOARDS[bd]->setPWM(pn, 0, upay > 4096 ? 4096 : upay);
        }
      }
      continue;
    }

    char c = (char)b;
    if(c == '?')      status();
    else if(c == 'v'){ verbose = !verbose; Serial.println(verbose ? F("verbose on") : F("verbose off")); }
    else if(c == 't'){ leaveLive(); sweeping = true; sweepAt = millis(); Serial.println(F("sweeping ch0 — x to stop")); }
    else if(c == 'w'){ leaveLive(); sweeping = false; maestro.stopScript();
                       walkOn = true; walkCh = 0; walkPhase = 0; walkAt = millis();
                       Serial.println(F("walking every channel — watch which servo moves; x to stop")); }
    else if(c == 'x'){ leaveLive(); sweeping = false; walkOn = false; maestro.stopScript();
                       for(uint8_t i=0;i<MPCA_CHANNELS;i++) maestro.setTarget(i,0);
                       Serial.println(F("off")); }
    else if(c >= '0' && c <= '9'){
      uint8_t n = c - '0';
      if(n < MPCA_SEQUENCES){ leaveLive(); sweeping = false; maestro.restartScript(n); Serial.print(F("slot ")); Serial.println(n); }
      else Serial.println(F("no such slot"));
    }
  }

  if(walkOn && millis() >= walkAt) walkStep();

  /* ---- bench sweep: proves servo + power with no host attached ---- */
  if(sweeping && millis() - sweepAt >= 20){
    sweepAt = millis();
    sweepPos += sweepDir * 8;
    if(sweepPos >= 7000){ sweepPos = 7000; sweepDir = -1; }   /* 1750 µs */
    if(sweepPos <= 5000){ sweepPos = 5000; sweepDir =  1; }   /* 1250 µs */
    maestro.setTarget(0, sweepPos);
  }
}
